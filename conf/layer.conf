## conf/layer.conf
```bitbake
# We have a conf and classes directory, add to BBPATH
BBPATH .= ":${LAYERDIR}"

# We have recipes-* directories, add to BBFILES
BBFILES += "${LAYERDIR}/recipes-*/*/*.bb \
            ${LAYERDIR}/recipes-*/*/*.bbappend"

BBFILE_COLLECTIONS += "meta-k37x"
BBFILE_PATTERN_meta-k37x = "^${LAYERDIR}/"
BBFILE_PRIORITY_meta-k37x = "6"

LAYERDEPENDS_meta-k37x = "core"
LAYERSERIES_COMPAT_meta-k37x = "warrior zeus"
```
